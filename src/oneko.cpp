#include "oneko.h"

static const uint8_t PROGMEM faces[24][512] = {
    {0x00, 0x00, 0x00, 0x00, 0x00, 0x00, 0x00, 0x00,
     0x00, 0x00, 0x00, 0x00, 0x00, 0x00, 0x00, 0x00,
     0x00, 0x00, 0x00, 0x0f, 0xf0, 0x00, 0x00, 0x00,
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     0x00, 0x00, 0x00, 0x00, 0x00, 0x00, 0x00, 0x00},
};

static const uint8_t warning[350] = {
    0x00, 0x00, 0x00, 0x00, 0x00, 0x00, 0x00,
    0x00, 0x00, 0x00, 0x00, 0x00, 0x00, 0x00,
    0x00, 0x00, 0x00, 0x00, 0x00, 0x00, 0x00,
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    0x00, 0x00, 0x00, 0x00, 0x00, 0x00, 0x00};

static const uint8_t PROGMEM tilt[10][350] = {
    {0x00, 0x00, 0x00, 0x00, 0x00, 0x00, 0x00,
     0x00, 0x00, 0x00, 0x00, 0x00, 0x00, 0x00,
     0x00, 0x00, 0x00, 0x00, 0x00, 0x00, 0x00,
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     0x00, 0x00, 0x00, 0x00, 0x00, 0x00, 0x00},

    {

        0x00, 0x00, 0x00, 0x00, 0x00, 0x00, 0x00,
        0x00, 0x00, 0x00, 0x00, 0x00, 0x00, 0x00,
        0x00, 0x00, 0x00, 0x00, 0x00, 0x00, 0x00,
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     0x00, 0x00, 0x00, 0x00, 0x00, 0x00, 0x00},

    {

        0x00, 0x00, 0x00, 0x00, 0x00, 0x00, 0x00,
        0x00, 0x00, 0x00, 0x00, 0x00, 0x00, 0x00,
        0x00, 0x00, 0x00, 0x00, 0x00, 0x00, 0x00,
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        0x00, 0x00, 0x00, 0x00, 0x00, 0x00, 0x00},

    {

        0x00, 0x00, 0x00, 0x00, 0x00, 0x00, 0x00,
        0x00, 0x00, 0x00, 0x00, 0x00, 0x00, 0x00,
        0x00, 0x00, 0x00, 0x00, 0x00, 0x00, 0x00,
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     0x00, 0x00, 0x00, 0x00, 0x00, 0x00, 0x00},

};

void Oneko::init()
{
    if (!display.begin(SSD1306_SWITCHCAPVCC, SCREEN_ADDRESS))
    {
        Serial.println(F("Display Initialization Error"));
        for (;;)
            ;
    }
    else
    {
        Serial.println("Display Initialized correctly!");
    }

    display.display();
    delay(2000);
    display.clearDisplay();

    display.setTextSize(1);
    display.setTextColor(WHITE);
}

bool Oneko::continue_with_error(int warning_duration)
{
    static bool show_error = true,
                frame1 = true;
    static long
        current_millis,
        pre_millis = millis();

    if (show_error)
    {
        current_millis = millis();

        if (current_millis - pre_millis >= warning_duration / 2)
        {
            if (frame1)
            {
                frame1 = false;
            }
            else
            {
                show_error = false;
            }
            pre_millis = millis();
        }

        display.clearDisplay();
        display.drawBitmap(39, 0, warning, 50, 50, 1);

        if (frame1)
        {
            display.setCursor(7, 56);
            display.print("Accelerometer Error");
        }
        else
        {
            display.setCursor(32, 56);
            display.print("Proceeding");
        }

        display.display();
    }

    return !show_error;
}

void Oneko::not_oriented(int frame_duration)
{
    static int frame = 1;
    static long
        current_millis,
        pre_millis = millis();
    static bool reverse = false;

    static char text[71] = "      Position the Device Vertically or Horizontal to the Ground      ";
    static char current_text[21];
    static int current_index = 0;

    current_millis = millis();

    if (current_millis - pre_millis >= frame_duration)
    {
        if (reverse)
        {
            frame--;
            if (frame < 1)
            {
                frame = 1;
                reverse = false;
            }
        }
        else
        {
            frame++;
            if (frame > 10)
            {
                frame = 10;
                reverse = true;
            }
        }

        if (current_index > 49)
        {
            current_index = 0;
        }

        for (int i = 0; i < 21; i++)
        {
            current_text[i] = text[i + current_index];
        }

        current_index++;
        pre_millis = millis();
    }

    display.clearDisplay();
    display.drawBitmap(39, 0, tilt[frame - 1], 50, 50, 1);
    display.setCursor(0, 56);
    display.print(current_text);
    display.setCursor(255, 255);
    display.display();
}

void Oneko::animate(int frame1, int frame2, int frame_duration)
{
    static long
        current_millis,
        pre_millis = millis();
    static bool show_frame1 = true;

    current_millis = millis();

    if (current_millis - pre_millis >= frame_duration)
    {
        if (show_frame1)
        {
            face(frame1);
        }
        else
        {
            face(frame2);
        }
        show_frame1 = !show_frame1;
        pre_millis = millis();
    }
}

void Oneko::face(int face)
{
    display.clearDisplay();
    display.drawBitmap(32, 0, faces[face - 1], 64, 64, 1);
    display.display();
}

void Oneko::scratch_ears(int frame_duration)
{
    animate(19, 20, frame_duration);
}

void Oneko::sleep(int frame_duration)
{
    animate(21, 22, frame_duration);
}

void Oneko::stay(
    long avg_wave_duration,
    long avg_sleep_duration,
    long wave_duration_offset,
    long sleep_duration_offset,
    long avg_wave_frequency,
    long avg_sleep_frequency,
    long wave_frequency_offset,
    long sleep_frequency_offset)
{
    static bool is_sleep = false,
                is_wave = false;
    static int wave_duration = avg_wave_duration,
               sleep_duration = avg_sleep_duration,
               wave_frequency = avg_wave_frequency,
               sleep_frequency = avg_sleep_frequency;

    static long
        wave_current,
        sleep_current,
        wave_pre = millis(),
        sleep_pre = millis(),
        wave_duration_current,
        sleep_duration_current,
        wave_duration_pre,
        sleep_duration_pre;

    wave_current = millis();
    sleep_current = millis();
    wave_duration_current = millis();
    sleep_duration_current = millis();

    if (is_moving)
    {
        is_wave = false;
        is_sleep = false;
        wave_pre = millis();
        sleep_pre = millis();
        new_sleep = true;
        sleep_frequency = 3000;

        is_moving = false;
    }

    if (is_wave)
    {
        if (wave_duration_current - wave_duration_pre >= wave_duration)
        {
            is_wave = false;
            wave_pre = millis();
            sleep_pre = millis();
        }
    }
    else
    {
        if (wave_current - wave_pre >= wave_frequency)
        {
            if (!is_sleep)
            {
                is_wave = true;

                randomSeed(millis());
                bool positive_duration = random(2);
                bool positive_frequency = random(2);

                if (positive_duration)
                {
                    wave_duration = avg_wave_duration + random(wave_duration_offset + 1);
                }
                else
                {
                    wave_duration = avg_wave_duration - random(wave_duration_offset + 1);
                }

                if (positive_frequency)
                {
                    wave_frequency = avg_wave_frequency + random(wave_frequency_offset + 1);
                }
                else
                {
                    wave_frequency = avg_wave_frequency - random(wave_frequency_offset + 1);
                }
            }
            wave_duration_pre = millis();
        }
    }

    if (is_sleep)
    {
        if (sleep_duration_current - sleep_duration_pre >= sleep_duration)
        {
            is_sleep = false;
            wave_frequency = random(2000, 5000);
            sleep_pre = millis();
            wave_pre = millis();
        }
    }
    else
    {
        if (sleep_current - sleep_pre >= sleep_frequency)
        {
            if (!is_wave)
            {
                is_sleep = true;

                randomSeed(millis());
                bool positive_duration = random(2);
                bool positive_frequency = random(2);

                if (positive_duration)
                {
                    sleep_duration = avg_sleep_duration + random(sleep_duration_offset + 1);
                }
                else
                {
                    sleep_duration = avg_sleep_duration - random(sleep_duration_offset + 1);
                }

                if (positive_frequency)
                {
                    sleep_frequency = avg_sleep_frequency + random(sleep_frequency_offset + 1);
                }
                else
                {
                    sleep_frequency = avg_sleep_frequency - random(sleep_frequency_offset + 1);
                }
            }
            sleep_duration_pre = millis();
        }
    }

    if (!is_sleep)
    {
        new_sleep = true;
    }

    if (!(is_sleep || is_wave))
        face(17);
    else if (is_wave)
    {
        wave();
    }
    else
    {
        go_to_sleep();
    }
}

void Oneko::go_to_sleep(int yawn_duration, int scratch_ears_duration)
{
    static long
        current_millis,
        pre_millis = millis();

    static bool is_yawn = true,
                is_scratch_ears = false;

    current_millis = millis();

    if (new_sleep)
    {
        is_yawn = true;
        is_scratch_ears = false;
        pre_millis = millis();
        new_sleep = false;
    }

    if (is_yawn)
    {
        face(18);
        if (current_millis - pre_millis >= yawn_duration)
        {
            is_yawn = false;
            is_scratch_ears = true;
            pre_millis = millis();
        }
    }
    else if (is_scratch_ears)
    {
        scratch_ears();
        if (current_millis - pre_millis >= scratch_ears_duration)
        {
            is_scratch_ears = false;
        }
    }
    else
    {
        sleep();
    }
}

void Oneko::move(int direction, int frame_duration)
{
    if (direction != 0)
    {
        is_moving = true;
    }

    switch (direction)
    {
    case 0:
        stay();
        break;

    case 1:
        animate(1, 2, frame_duration);
        break;

    case 2:
        animate(3, 4, frame_duration);
        break;

    case 3:
        animate(5, 6, frame_duration);
        break;

    case 4:
        animate(7, 8, frame_duration);
        break;

    case 5:
        animate(9, 10, frame_duration);
        break;

    case 6:
        animate(11, 12, frame_duration);
        break;

    case 7:
        animate(13, 14, frame_duration);
        break;

    case 8:
        animate(15, 16, frame_duration);
        break;

    default:
        break;
    }
}

void Oneko::wave(int frame_duration)
{
    animate(23, 24, frame_duration);
}